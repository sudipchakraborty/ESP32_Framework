#include "button.h"
#include <Arduino.h>
///////////////////////////
button::button(char sw_pin)  // Constructor
{   
    pin=sw_pin;
    logic=0;
}
//__________________________________________________________________________________________________________________________________________________________________
button::button(char sw_pin, bool state_logic)  // Constructor
{   
    pin=sw_pin;
    logic=state_logic;
}
//__________________________________________________________________________________________________________________________________________________________________
void button::begin()
{
    pinMode(pin, INPUT_PULLUP);
}
//__________________________________________________________________________________________________________________________________________________________________
 bool button::pressed()
{ 
  if (logic==1)
    {
      if(digitalRead(pin)) return true;
      else return false; 
    }
    else
    {
      if(digitalRead(pin)) return false;
      else return true; 
    }
}
//__________________________________________________________________________________________________________________________________________________________________
bool button::triggered(void)
{ 
   if (logic==1)
    {
      if(digitalRead(pin)) return true;
      else return false; 
    }
    else
    {
      if(digitalRead(pin)) return false;
      else return true; 
    }
}
//__________________________________________________________________________________________________________________________________________________________________
   
 
 
